## CMakeLists.txt
```
# Copyright (C) 2025 - OWL Services LLC
# SPDX-License-Identifier: Apache-2.0

cmake_minimum_required(VERSION 3.20.0)

find_package(Zephyr REQUIRED HINTS $ENV{ZEPHYR_BASE})
project(simpledll_sample)

target_sources(app PRIVATE src/main.c)
```

## sample.yaml
```
# Copyright (C) 2025 - OWL Services LLC
# SPDX-License-Identifier: Apache-2.0

sample:
  description: SimpleDLL sample application
  name: simpledll sample
common:
  build_only: true
  integration_platforms:
    - native_sim

tests:
  sample.subsys.sdll:
    tags:
      - uart
      - subsys
      - simpledll
```

## prj.conf
```kconfig
CONFIG_SIMPLEDLL=y
```

## src/main.c
```c
/*
 * Copyright (C) 2025 OWL Services LLC. All rights reserved.
 *
 * SPDX-License-Identifier: Apache-2.0
 */

#include <stdio.h>
#include <crc.h>
#include <subsys/simpledll/simpledll.h>

static struct sdll_context contexts[CONFIG_SIMPLEDLL_MAX_INSTANCES];



int main(void)
{
	/* TODO: Implement sample */

	return 0;
}
```
