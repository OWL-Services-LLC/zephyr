## CMakeLists.txt
```
# Copyright (C) 2025 - OWL Services LLC
# SPDX-License-Identifier: Apache-2.0

cmake_minimum_required(VERSION 3.20.0)

find_package(Zephyr REQUIRED HINTS $ENV{ZEPHYR_BASE})
project(sdll-basic)

target_sources(app PRIVATE src/main.c)
```

## sample.yaml
```
# Copyright (C) 2025 - OWL Services LLC
# SPDX-License-Identifier: Apache-2.0

sample:
  description: SDLL sample application
  name: sdll sample
common:
  build_only: true
  integration_platforms:
    - native_sim

tests:
  sample.subsys.sdll:
    tags:
      - uart
      - subsys
      - sdll
```

## prj.conf
```kconfig
CONFIG_SDLL=y
```

## src/main.c
```c
/*
 * Copyright (C) 2025 OWL Services LLC. All rights reserved.
 *
 * SPDX-License-Identifier: Apache-2.0
 */

#include <stdio.h>
#include <crc.h>
#include <subsys/sdll/sdll.h>

static struct sdll_context contexts[CONFIG_SDLL_MAX_INSTANCES];



int main(void)
{
	/* TODO: Implement sample */

	return 0;
}
```
